## defconfig
```kconfig
BR2_mipsel=y
BR2_mips_32r2=y
# BR2_MIPS_SOFT_FLOAT is not set
BR2_MIPS_FP32_MODE_32=y
BR2_TOOLCHAIN_BUILDROOT_UCLIBC=y
BR2_PACKAGE_HOST_LINUX_HEADERS_CUSTOM_3_10=y
BR2_GCC_VERSION_10_X=y
BR2_CCACHE=y
BR2_SHARED_STATIC_LIBS=y
BR2_TARGET_GENERIC_HOSTNAME="teacup"
BR2_TARGET_GENERIC_ROOT_PASSWD="teacup"
BR2_LINUX_KERNEL=y
BR2_LINUX_KERNEL_CUSTOM_GIT=y
BR2_LINUX_KERNEL_CUSTOM_REPO_URL="https://github.com/squash/linux-teacup.git"
BR2_LINUX_KERNEL_CUSTOM_REPO_VERSION="68e4b37"
BR2_LINUX_KERNEL_USE_CUSTOM_CONFIG=y
BR2_LINUX_KERNEL_CUSTOM_CONFIG_FILE="/root/br/buildroot-2023.02/board/teacup/kernel/t31.config"
BR2_LINUX_KERNEL_LZMA=y
BR2_PACKAGE_E2FSPROGS=y
BR2_PACKAGE_ZLIB=y
BR2_PACKAGE_NCURSES=y
BR2_PACKAGE_DROPBEAR=y
# BR2_PACKAGE_IFUPDOWN_SCRIPTS is not set
BR2_PACKAGE_LRZSZ=y
BR2_PACKAGE_WIRELESS_TOOLS=y
BR2_PACKAGE_WPA_SUPPLICANT=y
# BR2_PACKAGE_URANDOM_SCRIPTS is not set
BR2_PACKAGE_UTIL_LINUX_BINARIES=y
BR2_TARGET_ROOTFS_JFFS2=y
BR2_PACKAGE_HOST_UBOOT_TOOLS_FIT_SUPPORT=y
```
